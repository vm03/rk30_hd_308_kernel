## drivers/video/display/transmitter/Kconfig
```kconfig
choice
    depends on DISPLAY_SUPPORT
    prompt  "Display interface transmitter Select"

config NO_TRSM
	bool "no transmitter needed"

config RK610_LVDS
	bool "RK610(Jetta) lvds transmitter support"
	depends on MFD_RK610 
	help
		Support Jetta(RK610) to output LCD1 and LVDS.
		

config DP_RK_EDP
        bool "DP_RK_EDP"

config DP_ANX6345
	bool "RGB to Display Port transmitter anx6345,anx9804,anx9805 support"

endchoice
```
